#include <Tinyfont.h>
#include <ArduboyTones.h>
#include <Arduboy2.h>

Arduboy2 arduboy;
ArduboyTones sound(arduboy.audio.enabled);
Tinyfont tinyfont = Tinyfont(arduboy.sBuffer, Arduboy2::width(), Arduboy2::height());

const unsigned char skull[] PROGMEM = {
  0x00, 0x00, 0x04, 0x04, 0xe8, 0x10, 0xe8, 0xe8, 0x08, 0xe8, 0xe8, 0x10, 0xe8, 0x06, 0x00, 0x00,
  0x00, 0x00, 0x60, 0x20, 0x10, 0x0d, 0x12, 0x1e, 0x12, 0x1e, 0x12, 0x0d, 0x10, 0x20, 0x60, 0x00,
};

const unsigned char explosion[] PROGMEM = {
  0x87, 0x78, 0x00, 0x8f, 0x70, 0x03, 0xff, 0xff, 0xff, 0xff, 0x01, 0xfc, 0x02, 0x31, 0xec, 0x03,
  0x03, 0xc4, 0x38, 0x83, 0x78, 0x03, 0xff, 0xff, 0xff, 0xff, 0x1e, 0x84, 0x71, 0x0e, 0xe0, 0x1f,
  0x00, 0xff, 0x00, 0x7f, 0x80, 0x7f, 0xff, 0xff, 0xff, 0x1f, 0x40, 0xbf, 0x00, 0xff, 0x00, 0x00,
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  0x80, 0x60, 0x1f, 0xc0, 0x3f, 0x80, 0xe7, 0xff, 0xff, 0xff, 0x83, 0x3c, 0x42, 0x99, 0x64, 0x83,
};

const unsigned char gameOver[] PROGMEM = {
  0x00, 0x00, 0x00, 0x00, 0x00, 0x00, 0x00, 0x00, 0x00, 0x00, 0x00, 0x00, 0x00, 0x00, 0x00, 0x00,
0x00, 0x00, 0x00, 0x00, 0x00, 0x00, 0x00, 0x00, 0x00, 0x00, 0x00, 0x00, 0x00, 0x00, 0x00, 0x00,
0x00, 0x00, 0x00, 0x00, 0x00, 0x00, 0x00, 0x00, 0x00, 0x00, 0x00, 0x00, 0x00, 0x00, 0x00, 0x00,
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0x00, 0x00, 0x00, 0x00, 0x00, 0x00, 0x00, 0x00, 0x00, 0x00, 0x00, 0x00, 0x00, 0x00, 0x00, 0x00,
};

const unsigned char start[] PROGMEM = {
  0x07, 0x05, 0x7d, 0x41, 0x7d, 0x05, 0x07, 0x00, 0x7f, 0x41, 0x75, 0x15, 0x75, 0x41, 0x7f, 0x00,
  0x7f, 0x41, 0x7d, 0x41, 0x5f, 0x41, 0x7f, 0x00, 0x7f, 0x41, 0x63, 0x49, 0x7f, 0x00, 0x00, 0x00,
  0x7f, 0x41, 0x75, 0x1d, 0x07, 0x00, 0x7f, 0x41, 0x5d, 0x41, 0x7f, 0x00, 0x7f, 0x41, 0x75, 0x11,
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  0x00, 0xff, 0xff, 0xff, 0x00, 0x00, 0x00, 0xff, 0xff, 0xff, 0x00, 0x00, 0x00, 0xff, 0xff, 0xff,
};

byte screen = 1;                      //controls which screen gets rendered
byte landY[17];                       //array that saves the current terrain
byte rightY = 64;                     //the first y coordinate of the terrain
int tankX[] = {-8, 8, 8, -8, -8};     //array that saves the x coordinates of the tank vector
int tankY[] = {-4, -4, 4, 4, -4};     //array that saves the y coordinate of the tank vector
int eTankX[] = {-4, 4, 4, -4, -4};    //array that saves the x coordinates of the enemy vector
int eTankY[] = {-4, -4, 4, 4, -4};    //array that saves the y coordiantes of the enemy vector
int rot = 0;                          //saves the current tank rotation
byte tx = 0;                          //saves the current tank x coordinate
float ty = 0;                         //saves the current tank y coordiante
int wRot = 90;                        //saves the current gun rotation
float bulletX = 0;                    //bullet x coordiante
float bulletY = 0;                    //bullet y coordiante
boolean bulletState = false;          //whether the bullet currently exists or not
int bulletDir = 0;                    //direction the bullet is travelling
float xspd = 3;                       //horizontal speed of the bullet
float yspd = 2;                       //vertical speed of the bullet
float gravity = 0.2;                  //strength of gravity that affects the bullet
float resistance = 0.05;              //strength of air resistance that affects the bullet
byte enemyX = 0;                      //x cordiante of the enemy
byte enemyY = 0;                      //y cordiante of the enemy
boolean enemyState = false;           //whether or not the enemy is alive curently
int enemyRot = 0;                     //crrent enemy rotation
byte last = 0;                        //the amount of points you got from the last kill
unsigned int points = 0;              //the amount of points the player has
byte mortarX = 200;                   //x coordinate of the mortar. starts at 200 to not be visible first cycle
boolean mortarState = true;           //whether the mortar is curretly warning or damaging
int timer = 0;                        //timer that controls how long the mortar warns and goes of for
boolean controlSheme = true;          //which control sheme the player has chosen to use (true left/right for gun)

void setup() {
    //Serial.begin(115200);
  arduboy.begin();
  arduboy.setFrameRate(30);
  arduboy.initRandomSeed();
  arduboy.clear();
  //generates the terrain for the first level
  initLand();
  //spawns the enemy for the first level
  spawnEnemy();
  //Serial.println(PIN_LEFT_BUTTON);
  //Serial.println(PIN_RIGHT_BUTTON);
  //Serial.println(PIN_UP_BUTTON);
  //Serial.println(PIN_DOWN_BUTTON);
}

void loop() {
  if (!(arduboy.nextFrame())) {
    return;
  }
  arduboy.pollButtons();
  arduboy.clear();

  //game screen
  if (screen == 0) {
    toggleSound();
    setEnemyRot();
    destroyBulletOutOfBounds();
    killEnemy();
    setTankRot();
    setTankY();
    moveBullet();
    if (controlSheme) {
      moveTank();
      moveGun();
    } else {
      moveTank2();
      moveGun2();
    }
    shoot();
    drawLand();
    destroyBulletTerrainCollision();
    drawMortarZone();
    mortarExplode();
    drawVectorRot(tx, ty, tankX, tankY, 5, 100, 100, rot);
    if (enemyState) {
      drawVectorRot(enemyX, enemyY, eTankX, eTankY, 5, 100, 100, enemyRot);
    }
    drawGun();
    drawBullet();
    drawUI();
  }
  //start screen
  if (screen == 1) {
    arduboy.drawBitmap(0, 0, start, 128, 64, WHITE);
    if (arduboy.justPressed(A_BUTTON)) {
      screen = 0;
    }
    if (arduboy.justPressed(B_BUTTON)) {
      controlSheme = !controlSheme;
    }
    tinyfont.setCursor(0, 60);
    if (controlSheme) {
      tinyfont.print("A");
    } else {
      tinyfont.print("B");
    }
  }
  //game over screen
  if (screen == 2) {
    arduboy.drawBitmap(0, 0, gameOver, 128, 64, WHITE);
    tinyfont.setCursor(60, 18);
    tinyfont.print(points);
    if (arduboy.justPressed(A_BUTTON)) {
      screen = 1;
      points = 0;
      last = 0;
    }
  }
  arduboy.display();
}

//draws the exploded mortar and starts the timer to switc to the warning state
void mortarExplode() {
  if (mortarState) {
    sound.tone(70, 66);
    arduboy.drawBitmap(mortarX -8, -arduboy.frameCount % 64, explosion, 16, 64, WHITE);
    arduboy.drawBitmap(mortarX -8, (-arduboy.frameCount % 64) - 64, explosion, 16, 64, WHITE);
    if (arduboy.frameCount - timer > 30) {
      mortarX = random(tx - 16, tx + 16);
      mortarState = false;
      timer = arduboy.frameCount;
    }
  }
}

//draws the mortar warning and starts the timer to switch to the exploded state
void drawMortarZone() {
  if (!mortarState) {
    if (arduboy.everyXFrames(2)) {
      arduboy.drawBitmap(mortarX - 8, 10, skull, 16, 16, WHITE);
    }
    arduboy.drawFastVLine(mortarX - 8, 6, 58, WHITE);
    arduboy.drawFastVLine(mortarX + 8, 6, 58, WHITE);
    if (arduboy.frameCount - timer > 60) {
      mortarState = true;
      timer = arduboy.frameCount;
      if (tx < mortarX + 8 and tx > mortarX - 8) {
        sound.tone(300, 150, 150, 150, 50, 150);
        screen = 2;
      }
    }
  }
}

//draws points
void drawUI() {
  arduboy.fillRect(0, 0, 128, 5, BLACK);
  tinyfont.setCursor(0, 0);
  tinyfont.print("LAST:");
  tinyfont.print(last);
  tinyfont.setCursor(48, 0);
  tinyfont.print("POINTS:");
  tinyfont.print(points);
}

//destroys the bullet if a white pixel is above the bullet (only takes the pixels into account that have been drawn by this point)
void destroyBulletTerrainCollision() {
  if (bulletState) {
    for (int y = 0; y < bulletY; y++) {
      if (arduboy.getPixel(bulletX, y) == WHITE and y <= bulletY) {
        bulletState = false;
        sound.tone(50, 125);
        int i = bulletX / 8;
        landY[i] += 4;
        if (landY[i] > 63) {
          landY[i] = 63;
        }
        return;
      }
    }
  }
}

//destroys enemy and bullet if they collide
void killEnemy() {
  if (bulletState and enemyState) {
    Rect rectEnemy{enemyX - 5, enemyY - 5, 10, 10};
    Point pointBullet{bulletX, bulletY};
    if (arduboy.collide(pointBullet, rectEnemy)) {
      last = abs(enemyX - tx);
      points += last;
      bulletState = false;
      enemyState = false;
      sound.tone(50, 100, 40, 100);
    }
  }
}

//destroys the bullet if it leaves the screen to the sides of bottom
void destroyBulletOutOfBounds() {
  if (bulletState) {
    if (bulletX > 128 or bulletX < 0) {
      bulletState = false;
    }
    if (bulletY > 64) {
      bulletState = false;
    }
  }
}

//calculates the rotation the enemy needs to have based on the slant of the terrain below
void setEnemyRot() {
  if (enemyState) {
    enemyRot = getAngle(enemyX - (enemyX % 8), landY[enemyX/8], (enemyX + 8) - (enemyX % 8), landY[(enemyX/8)+1]);
  }
}

//spawns an enemy and calculates the y coordinate based on the terrain
void spawnEnemy() {
  if (!enemyState) {
    enemyState = true;
    enemyX = random(64, 120);

    
  byte x1 = enemyX - (enemyX % 8);
  byte y1 = landY[enemyX/8];
  
  byte x2 = (enemyX + 8) - (enemyX % 8);
  byte y2 = landY[(enemyX/8)+1];

  float m1 = y2 - y1;
  float m2 = x2 - x1;
  float m = m1/m2;
  float b = y1 - (x1 * m);

  float fEnemyX = enemyX;
  enemyY = ((m * fEnemyX) + b)-3;
  }
}

//moves the bullet in the coresponding dirction
void moveBullet() {
  if (bulletState) {
    bulletX = bulletX + lendirX(xspd, bulletDir);
    bulletY = bulletY + lendirY(yspd, bulletDir);
  }
  xspd -= resistance;
  yspd -= gravity;
  yspd -= resistance;
  if (xspd < 0) {
    xspd = 0;
  }
  if (xspd <= 0 and yspd <= 0) {
    bulletState = false;
  }
}

void shoot() {
  if (arduboy.justPressed(A_BUTTON)) {
    if (!bulletState) {
      sound.tone(750, 75);
      bulletState = true;
      bulletDir = rot + wRot;
      bulletX = tx + lendirX(10, bulletDir);
      bulletY = ty + lendirY(10, bulletDir);
      xspd = 5;
      yspd = 5;
    }
  }
}
void drawBullet() {
  if (bulletState) {
    //arduboy.fillCircle(bulletX, bulletY, 1, WHITE);
    arduboy.drawPixel(bulletX, bulletY, WHITE);
  }
}

void drawGun() {
  arduboy.drawLine(tx, ty, tx + lendirX(10, rot + wRot), ty + lendirY(10, rot + wRot), WHITE);
}

//calculates the tank y coordinate based ont the terrain below
void setTankY() {
  byte x1 = tx - (tx % 8);
  byte y1 = landY[tx/8];
  
  byte x2 = (tx + 8) - (tx % 8);
  byte y2 = landY[(tx/8)+1];

  float m1 = y2 - y1;
  float m2 = x2 - x1;
  float m = m1/m2;
  float b = y1 - (x1 * m);

  float ftx = tx;
  ty = ((m * ftx) + b)-3;
}

//calculates the tank rotation based on the terrain below
void setTankRot() {
  rot = getAngle(tx - (tx % 8), landY[tx/8], (tx + 8) - (tx % 8), landY[(tx/8)+1]);
}

//moves the tank and generates a new level when the screen is left to the right
void moveTank() {
  if (arduboy.pressed(UP_BUTTON)) {
    tx++;
  }
  if (arduboy.pressed(DOWN_BUTTON)) {
    tx--;
  }
  if (tx < 8) {
    tx = 8;
  }
  if (tx > 127) {
    tx = 0;
    initLand();
    bulletState = false;
    enemyState = false;
    spawnEnemy();
    mortarX = 200;
    mortarState = false;
    timer = arduboy.frameCount;
  }
  if (enemyX - tx < 10 and enemyState) {
    tx--;
  }
}

//same as moveTank but uses other control sheme
void moveTank2() {
  if (arduboy.pressed(RIGHT_BUTTON)) {
    tx++;
  }
  if (arduboy.pressed(LEFT_BUTTON)) {
    tx--;
  }
  if (tx < 8) {
    tx = 8;
  }
  if (tx > 127) {
    tx = 0;
    initLand();
    bulletState = false;
    enemyState = false;
    spawnEnemy();
    mortarX = 200;
    mortarState = false;
    timer = arduboy.frameCount;
  }
  if (enemyX - tx < 10 and enemyState) {
    tx--;
  }
}

//generates the terrain
void initLand() {
  byte lastY = rightY;
  for (int i = 0; i < 17; i++) {
    landY[i] = lastY;
    lastY += random(-8, 9);
    if (lastY < 16) {
      lastY = 16;
    }
    if (lastY > 63) {
      lastY = 63;
    }
  }
  rightY = landY[16];
}

//rotates the gun
void moveGun() {
  if (arduboy.pressed(RIGHT_BUTTON)) {
    wRot -= 1;
  }
  if (arduboy.pressed(LEFT_BUTTON)) {
    wRot += 1;
  }
  if (wRot > 180) {
    wRot = 180;
  }
  if (wRot < 0) {
    wRot = 0;
  }
}

//same as moveGun but with ither control sheme
void moveGun2() {
  if (arduboy.pressed(UP_BUTTON)) {
    wRot += 1;
  }
  if (arduboy.pressed(DOWN_BUTTON)) {
    wRot -= 1;
  }
  if (wRot > 90) {
    wRot = 90;
  }
  if (wRot < 1) {
    wRot = 1;
  }
}

void drawLand() {
  for (int i = 0; i < 16; i++) {
    arduboy.drawLine(8 * i, landY[i], 8 * (i+1), landY[i+1], WHITE);
  }
}

//calculates the x coordinate of a point based on the direction and distance of that point (relative to 0,0)
float lendirX(int len, int dir) {
  dir = ((dir % 360) + 360) % 360;
  dir = dir - 360;
  
  if (dir < 90) {
    return (cos(dir * (3.14159265359f / 180.0f)) * len);
  }
  if (dir > 90 and dir < 180) {
    return -(cos(dir * (3.14159265359f / 180.0f)) * len);
  }
  if (dir > 180 and dir < 270) {
    return -(cos(dir * (3.14159265359f / 180.0f)) * len);
  }
  if (dir > 270) {
    return (cos(dir * (3.14159265359f / 180.0f)) * len);
  }
  if (dir == 0 or dir == 360) {
    return len;
  }
  if (dir == 90 or dir == 270) {
    return 0;
  }
  if (dir == 180) {
    return - len;
  }
}

//calculates the y coordinate of a point based on the direction and distance of that point (relative to 0,0)
float lendirY(int len, int dir) {
  dir = ((dir % 360) + 360) % 360;
  dir = dir - 360;

  if (dir < 90) {
    return -(sin(dir * (3.14159265359f / 180.0f)) * len);
  }
  if (dir > 90 and dir < 180) {
    return -(sin(dir * (3.14159265359f / 180.0f)) * len);
  }
  if (dir > 180 and dir < 270) {
    return (sin(dir * (3.14159265359f / 180.0f)) * len);
  }
  if (dir > 270) {
    return (sin(dir * (3.14159265359f / 180.0f)) * len);
  }
  if (dir == 0 or dir == 360 or dir == 180) {
    return 0;
  }
  if (dir == 90) {
    return - len;
  }
  if (dir == 270) {
    return len;
  }
}

//draws a vector with x array, y array, x coordiante, y coordiante, number of elemtns in array, xscale, yscale, roation
void drawVectorRot(int xc, int yc, int x[], int y[],byte len, int xscale, int yscale, int rot) {
  for (int i = 0; i <= len-2; i++) {
    int leni = getDistance(0, 0, x[i], y[i]);
    int diri = getAngle(0, 0, x[i], y[i]);

    int lenii = getDistance(0, 0, x[i+1], y[i+1]);
    int dirii = getAngle(0, 0, x[i+1], y[i+1]);

    arduboy.drawLine(xc + lendirX(leni * xscale/100, diri + rot), yc + lendirY(leni * yscale/100, diri + rot), xc + lendirX(lenii * xscale/100, dirii + rot), yc + lendirY(lenii * yscale/100, dirii + rot), WHITE);
  }
}

//gets the distance between 2 points
byte getDistance(int x1, int y1, int x2, int y2) {
  int dx = max(x1, x2) - min(x1, x2);
  int dy = max(y1, y2) - min(y1, y2);

  return sqrt(sq(dx) + sq(dy));
}

//gets the angle between 2 points relative to horizontal
int getAngle(int x1, int y1, int x2, int y2) {
  int angle = (atan2(y1 - y2, x1 - x2) * 180 / 3.14159265359f);
  angle = (((-(angle + 180)) % 360)+ 360)% 360;
  return angle;
}

//toggles the sound between on and off and saves the current state
void toggleSound() {
  if (arduboy.justPressed(B_BUTTON)) {
    arduboy.audio.toggle();
    sound.tone(1000, 50);
    arduboy.audio.saveOnOff();
  }
}
